## pchu_app/ina219_tester/Kconfig
```kconfig
#
# For a description of the syntax of this configuration file,
# see the file kconfig-language.txt in the NuttX tools repository.
#

config PCHU_INA219
	tristate "INA219 Tester"
	default n
	depends on SENSORS_INA219
	---help---
		Enable the INA219 tester

if PCHU_INA219

config PCHU_INA219_PROGNAME
	string "Program name"
	default "ina219_test"
	---help---
		This is the name of the program that will be used when the NSH ELF
		program is installed.

config PCHU_INA219_PRIORITY
	int "INA219 task priority"
	default 100

config PCHU_INA219_STACKSIZE
	int "INA219 stack size"
	default DEFAULT_TASK_STACKSIZE

endif
```

## pchu_app/pchu/Kconfig
```kconfig
#
# For a description of the syntax of this configuration file,
# see the file kconfig-language.txt in the NuttX tools repository.
#

config PCHU_MANAGER
	tristate "Manager app"
	default n
	---help---
		Enable the manager application

if PCHU_MANAGER

config PCHU_MANAGER_PROGNAME
	string "Program name"
	default "ManagerApp"
	---help---
		This is the name of the program that will be used when the NSH ELF
		program is installed.

config PCHU_MANAGER_PRIORITY
	int "Manager task priority"
	default 100

config PCHU_MANAGER_STACKSIZE
	int "Manager app stack size"
	default DEFAULT_TASK_STACKSIZE

endif
```
